## ble_mesh_tfg/vendor_client/main/Kconfig.projbuild
```kconfig
menu "TFG Mesh Configuration"

    config MQTT_BROKER_URI
        string "URI del Broker MQTT"
        default "mqtt://192.168.1.35:1883"

    config MQTT_USERNAME
        string "MQTT Username"
        default "WifiMeshUser"

    config MQTT_PASSWORD
        string "MQTT Password"
        default "12345678"

    config MESH_SSID
        string "SSID de la red mesh interna"
        default "TFG_Mesh_Network"

    config MESH_PASSWORD
        string "Contraseña de la red mesh"
        default "mesh_pass"

endmenu
```

## wifi_mesh_tfg/main/Kconfig.projbuild
```kconfig
menu "TFG Mesh Configuration"

    config MQTT_BROKER_URI
        string "URI del Broker MQTT"
        default "mqtt://192.168.1.37:1883"

    config MQTT_USERNAME
        string "MQTT Username"
        default "WifiMeshUser"

    config MQTT_PASSWORD
        string "MQTT Password"
        default "12345678"

    config MESH_SSID
        string "SSID de la red mesh interna"
        default "TFG_Mesh_Network"

    config MESH_PASSWORD
        string "Contraseña de la red mesh"
        default "mesh_pass"


    config MESH_ROUTER_PASS
        string "Contraseña del router externo"
        default "router_password"

    config MESH_MAX_LAYER
        int "Número máximo de capas en la malla"
        default 4
        range 1 25

    config MESH_TX_INTERVAL_MS
        int "Intervalo de envío de métricas (ms)"
        default 5000
        range 1000 60000

    config MESH_PING_INTERVAL_MS
        int "Intervalo de ping para medir latencia (ms)"
        default 10000
        range 2000 120000

endmenu
```
